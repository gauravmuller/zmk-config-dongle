## boards/shields/ssxb_corne/Kconfig.defconfig
```kconfig
if SHIELD_SSXB_CORNE_DONGLE

config ZMK_KEYBOARD_NAME
    default "SSBX_Corne"

config ZMK_SPLIT_ROLE_CENTRAL
    default y

config ZMK_SPLIT
    default y

config ZMK_SPLIT_BLE_CENTRAL_PERIPHERALS
    default 2

config BT_MAX_CONN
    default 5

config BT_MAX_PAIRED
    default 5

endif

if SHIELD_SSXB_CORNE_LEFT || SHIELD_SSXB_CORNE_RIGHT

config ZMK_SPLIT
    default y

endif
```

## boards/shields/ssxb_corne/Kconfig.shield
```kconfig
config SHIELD_SSXB_CORNE_LEFT
    def_bool $(shields_list_contains,ssxb_corne_left)

config SHIELD_SSXB_CORNE_RIGHT
    def_bool $(shields_list_contains,ssxb_corne_right)

config SHIELD_SSXB_CORNE_DONGLE
    def_bool $(shields_list_contains,ssxb_corne_dongle)
```
